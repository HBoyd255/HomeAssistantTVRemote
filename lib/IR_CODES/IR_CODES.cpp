#include <Arduino.h>

#include "IR_CODES.h"


const String retrieve_led_string_from_flash(const String code_name) {
    if (code_name == LED_BRIGHTNESS_UP_NAME) {return F(LED_BRIGHTNESS_UP_STRING);}
    else if (code_name == LED_BRIGHTNESS_DOWN_NAME) {return F(LED_BRIGHTNESS_DOWN_STRING);}
    else if (code_name == LED_OFF_NAME) {return F(LED_OFF_STRING);}
    else if (code_name == LED_ON_NAME) {return F(LED_ON_STRING);}
    else if (code_name == LED_RED_NAME) {return F(LED_RED_STRING);}
    else if (code_name == LED_GREEN_NAME) {return F(LED_GREEN_STRING);}
    else if (code_name == LED_BLUE_NAME) {return F(LED_BLUE_STRING);}
    else if (code_name == LED_WHITE_NAME) {return F(LED_WHITE_STRING);}
    else if (code_name == LED_LIGHT_RED_NAME) {return F(LED_LIGHT_RED_STRING);}
    else if (code_name == LED_LIGHT_GREEN_NAME) {return F(LED_LIGHT_GREEN_STRING);}
    else if (code_name == LED_LIGHT_BLUE_NAME) {return F(LED_LIGHT_BLUE_STRING);}
    else if (code_name == LED_FLASH_NAME) {return F(LED_FLASH_STRING);}
    else if (code_name == LED_DARK_ORANGE_NAME) {return F(LED_DARK_ORANGE_STRING);}
    else if (code_name == LED_SKY_BLUE_NAME) {return F(LED_SKY_BLUE_STRING);}
    else if (code_name == LED_PURPLE_NAME) {return F(LED_PURPLE_STRING);}
    else if (code_name == LED_STROBE_NAME) {return F(LED_STROBE_STRING);}
    else if (code_name == LED_LIGHT_ORANGE_NAME) {return F(LED_LIGHT_ORANGE_STRING);}
    else if (code_name == LED_SWAMP_BLUE_NAME) {return F(LED_SWAMP_BLUE_STRING);}
    else if (code_name == LED_LIGHT_PURPLE_NAME) {return F(LED_LIGHT_PURPLE_STRING);}
    else if (code_name == LED_FADE_NAME) {return F(LED_FADE_STRING);}
    else if (code_name == LED_YELLOW_NAME) {return F(LED_YELLOW_STRING);}
    else if (code_name == LED_SEA_BLUE_NAME) {return F(LED_SEA_BLUE_STRING);}
    else if (code_name == LED_PONK_NAME) {return F(LED_PONK_STRING);}
    else if (code_name == LED_SMOOTH_NAME) {return F(LED_SMOOTH_STRING);}
    else if (code_name == LED_REPEAT_NAME) {return F(LED_REPEAT_STRING);}
    else if (code_name == SAMSUNG_POWER_NAME) {return F(SAMSUNG_POWER_STRING);}
    else if (code_name == SAMSUNG_SOURCE_NAME) {return F(SAMSUNG_SOURCE_STRING);}
    else if (code_name == SAMSUNG_ONE_NAME) {return F(SAMSUNG_ONE_STRING);}
    else if (code_name == SAMSUNG_TWO_NAME) {return F(SAMSUNG_TWO_STRING);}
    else if (code_name == SAMSUNG_THREE_NAME) {return F(SAMSUNG_THREE_STRING);}
    else if (code_name == SAMSUNG_FOUR_NAME) {return F(SAMSUNG_FOUR_STRING);}
    else if (code_name == SAMSUNG_FIVE_NAME) {return F(SAMSUNG_FIVE_STRING);}
    else if (code_name == SAMSUNG_SIX_NAME) {return F(SAMSUNG_SIX_STRING);}
    else if (code_name == SAMSUNG_SEVEN_NAME) {return F(SAMSUNG_SEVEN_STRING);}
    else if (code_name == SAMSUNG_EIGHT_NAME) {return F(SAMSUNG_EIGHT_STRING);}
    else if (code_name == SAMSUNG_NINE_NAME) {return F(SAMSUNG_NINE_STRING);}
    else if (code_name == SAMSUNG_TTX_NAME) {return F(SAMSUNG_TTX_STRING);}
    else if (code_name == SAMSUNG_ZERO_NAME) {return F(SAMSUNG_ZERO_STRING);}
    else if (code_name == SAMSUNG_PRE_CH_NAME) {return F(SAMSUNG_PRE_CH_STRING);}
    else if (code_name == SAMSUNG_VOLUME_UP_NAME) {return F(SAMSUNG_VOLUME_UP_STRING);}
    else if (code_name == SAMSUNG_MUTE_NAME) {return F(SAMSUNG_MUTE_STRING);}
    else if (code_name == SAMSUNG_CHANNEL_UP_NAME) {return F(SAMSUNG_CHANNEL_UP_STRING);}
    else if (code_name == SAMSUNG_VOLUME_DOWN_NAME) {return F(SAMSUNG_VOLUME_DOWN_STRING);}
    else if (code_name == SAMSUNG_CH_LIST_NAME) {return F(SAMSUNG_CH_LIST_STRING);}
    else if (code_name == SAMSUNG_CHANNEL_DOWN_NAME) {return F(SAMSUNG_CHANNEL_DOWN_STRING);}
    else if (code_name == SAMSUNG_MENU_NAME) {return F(SAMSUNG_MENU_STRING);}
    else if (code_name == SAMSUNG_SMART_HUB_NAME) {return F(SAMSUNG_SMART_HUB_STRING);}
    else if (code_name == SAMSUNG_GUIDE_NAME) {return F(SAMSUNG_GUIDE_STRING);}
    else if (code_name == SAMSUNG_TOOLS_NAME) {return F(SAMSUNG_TOOLS_STRING);}
    else if (code_name == SAMSUNG_UP_NAME) {return F(SAMSUNG_UP_STRING);}
    else if (code_name == SAMSUNG_INFO_NAME) {return F(SAMSUNG_INFO_STRING);}
    else if (code_name == SAMSUNG_LEFT_NAME) {return F(SAMSUNG_LEFT_STRING);}
    else if (code_name == SAMSUNG_ENTER_NAME) {return F(SAMSUNG_ENTER_STRING);}
    else if (code_name == SAMSUNG_RIGHT_NAME) {return F(SAMSUNG_RIGHT_STRING);}
    else if (code_name == SAMSUNG_RETURN_NAME) {return F(SAMSUNG_RETURN_STRING);}
    else if (code_name == SAMSUNG_DOWN_NAME) {return F(SAMSUNG_DOWN_STRING);}
    else if (code_name == SAMSUNG_EXIT_NAME) {return F(SAMSUNG_EXIT_STRING);}
    else if (code_name == SAMSUNG_RED_NAME) {return F(SAMSUNG_RED_STRING);}
    else if (code_name == SAMSUNG_GREEN_NAME) {return F(SAMSUNG_GREEN_STRING);}
    else if (code_name == SAMSUNG_YELLOW_NAME) {return F(SAMSUNG_YELLOW_STRING);}
    else if (code_name == SAMSUNG_BLUE_NAME) {return F(SAMSUNG_BLUE_STRING);}
    else if (code_name == SAMSUNG_E_MANUAL_NAME) {return F(SAMSUNG_E_MANUAL_STRING);}
    else if (code_name == SAMSUNG_SPORTS_NAME) {return F(SAMSUNG_SPORTS_STRING);}
    else if (code_name == SAMSUNG_AD_SUBT_NAME) {return F(SAMSUNG_AD_SUBT_STRING);}
    else if (code_name == SAMSUNG_STOP_NAME) {return F(SAMSUNG_STOP_STRING);}
    else if (code_name == SAMSUNG_REWIND_NAME) {return F(SAMSUNG_REWIND_STRING);}
    else if (code_name == SAMSUNG_PLAY_NAME) {return F(SAMSUNG_PLAY_STRING);}
    else if (code_name == SAMSUNG_PAUSE_NAME) {return F(SAMSUNG_PAUSE_STRING);}
    else if (code_name == SAMSUNG_FAST_FORWARD_NAME) {return F(SAMSUNG_FAST_FORWARD_STRING);}
    else if (code_name == TIVO_POWER_NAME) {return F(TIVO_POWER_STRING);}
    else if (code_name == TIVO_GUIDE_NAME) {return F(TIVO_GUIDE_STRING);}
    else if (code_name == TIVO_MUTE_NAME) {return F(TIVO_MUTE_STRING);}
    else if (code_name == TIVO_REWIND_NAME) {return F(TIVO_REWIND_STRING);}
    else if (code_name == TIVO_PAUSE_NAME) {return F(TIVO_PAUSE_STRING);}
    else if (code_name == TIVO_FAST_FORWARD_NAME) {return F(TIVO_FAST_FORWARD_STRING);}
    else if (code_name == TIVO_RED_NAME) {return F(TIVO_RED_STRING);}
    else if (code_name == TIVO_GREEN_NAME) {return F(TIVO_GREEN_STRING);}
    else if (code_name == TIVO_YELLOW_NAME) {return F(TIVO_YELLOW_STRING);}
    else if (code_name == TIVO_BLUE_NAME) {return F(TIVO_BLUE_STRING);}
    else if (code_name == TIVO_UP_NAME) {return F(TIVO_UP_STRING);}
    else if (code_name == TIVO_LEFT_NAME) {return F(TIVO_LEFT_STRING);}
    else if (code_name == TIVO_OK_NAME) {return F(TIVO_OK_STRING);}
    else if (code_name == TIVO_RIGHT_NAME) {return F(TIVO_RIGHT_STRING);}
    else if (code_name == TIVO_DOWN_NAME) {return F(TIVO_DOWN_STRING);}
    else if (code_name == TIVO_RETURN_NAME) {return F(TIVO_RETURN_STRING);}
    else if (code_name == TIVO_TIVO_NAME) {return F(TIVO_TIVO_STRING);}
    else if (code_name == TIVO_INFO_NAME) {return F(TIVO_INFO_STRING);}
    else if (code_name == TIVO_VOLUME_UP_NAME) {return F(TIVO_VOLUME_UP_STRING);}
    else if (code_name == TIVO_VOLUME_DOWN_NAME) {return F(TIVO_VOLUME_DOWN_STRING);}
    else if (code_name == TIVO_CHANNEL_UP_NAME) {return F(TIVO_CHANNEL_UP_STRING);}
    else if (code_name == TIVO_CHANNEL_DOWN_NAME) {return F(TIVO_CHANNEL_DOWN_STRING);}
    else if (code_name == TIVO_YOUTUBE_NAME) {return F(TIVO_YOUTUBE_STRING);}
    else if (code_name == TIVO_NETFLIX_NAME) {return F(TIVO_NETFLIX_STRING);}
    else if (code_name == TIVO_PRIME_VIDEO_NAME) {return F(TIVO_PRIME_VIDEO_STRING);}
    else if (code_name == TIVO_DISNEY_NAME) {return F(TIVO_DISNEY_STRING);}
    else if (code_name == TIVO_FREE_NAME) {return F(TIVO_FREE_STRING);}
    else if (code_name == TIVO_FREELY_NAME) {return F(TIVO_FREELY_STRING);}
    else if (code_name == TIVO_ONE_NAME) {return F(TIVO_ONE_STRING);}
    else if (code_name == TIVO_TWO_NAME) {return F(TIVO_TWO_STRING);}
    else if (code_name == TIVO_THREE_NAME) {return F(TIVO_THREE_STRING);}
    else if (code_name == TIVO_FOUR_NAME) {return F(TIVO_FOUR_STRING);}
    else if (code_name == TIVO_FIVE_NAME) {return F(TIVO_FIVE_STRING);}
    else if (code_name == TIVO_SIX_NAME) {return F(TIVO_SIX_STRING);}
    else if (code_name == TIVO_SEVEN_NAME) {return F(TIVO_SEVEN_STRING);}
    else if (code_name == TIVO_EIGHT_NAME) {return F(TIVO_EIGHT_STRING);}
    else if (code_name == TIVO_NINE_NAME) {return F(TIVO_NINE_STRING);}
    else if (code_name == TIVO_SUB_NAME) {return F(TIVO_SUB_STRING);}
    else if (code_name == TIVO_ZERO_NAME) {return F(TIVO_ZERO_STRING);}
    else if (code_name == TIVO_SETTINGS_NAME) {return F(TIVO_SETTINGS_STRING);}
    else if (code_name == TOSHIBA_SOURCE_NAME) {return F(TOSHIBA_SOURCE_STRING);}
    else if (code_name == TOSHIBA_POWER_NAME) {return F(TOSHIBA_POWER_STRING);}
    else if (code_name == TOSHIBA_STILL_PICTURE_NAME) {return F(TOSHIBA_STILL_PICTURE_STRING);}
    else if (code_name == TOSHIBA_TEXT_NAME) {return F(TOSHIBA_TEXT_STRING);}
    else if (code_name == TOSHIBA_SUBTITLE_NAME) {return F(TOSHIBA_SUBTITLE_STRING);}
    else if (code_name == TOSHIBA_STEREO_NAME) {return F(TOSHIBA_STEREO_STRING);}
    else if (code_name == TOSHIBA_ONE_NAME) {return F(TOSHIBA_ONE_STRING);}
    else if (code_name == TOSHIBA_TWO_NAME) {return F(TOSHIBA_TWO_STRING);}
    else if (code_name == TOSHIBA_THREE_NAME) {return F(TOSHIBA_THREE_STRING);}
    else if (code_name == TOSHIBA_FOUR_NAME) {return F(TOSHIBA_FOUR_STRING);}
    else if (code_name == TOSHIBA_FIVE_NAME) {return F(TOSHIBA_FIVE_STRING);}
    else if (code_name == TOSHIBA_SIX_NAME) {return F(TOSHIBA_SIX_STRING);}
    else if (code_name == TOSHIBA_SEVEN_NAME) {return F(TOSHIBA_SEVEN_STRING);}
    else if (code_name == TOSHIBA_EIGHT_NAME) {return F(TOSHIBA_EIGHT_STRING);}
    else if (code_name == TOSHIBA_NINE_NAME) {return F(TOSHIBA_NINE_STRING);}
    else if (code_name == TOSHIBA_AD_NAME) {return F(TOSHIBA_AD_STRING);}
    else if (code_name == TOSHIBA_ZERO_NAME) {return F(TOSHIBA_ZERO_STRING);}
    else if (code_name == TOSHIBA_ATV_DTV_NAME) {return F(TOSHIBA_ATV_DTV_STRING);}
    else if (code_name == TOSHIBA_VOLUME_UP_NAME) {return F(TOSHIBA_VOLUME_UP_STRING);}
    else if (code_name == TOSHIBA_VOLUME_DOWN_NAME) {return F(TOSHIBA_VOLUME_DOWN_STRING);}
    else if (code_name == TOSHIBA_INFO_NAME) {return F(TOSHIBA_INFO_STRING);}
    else if (code_name == TOSHIBA_MUTE_NAME) {return F(TOSHIBA_MUTE_STRING);}
    else if (code_name == TOSHIBA_QUICK_NAME) {return F(TOSHIBA_QUICK_STRING);}
    else if (code_name == TOSHIBA_CHANNEL_UP_NAME) {return F(TOSHIBA_CHANNEL_UP_STRING);}
    else if (code_name == TOSHIBA_CHANNEL_DOWN_NAME) {return F(TOSHIBA_CHANNEL_DOWN_STRING);}
    else if (code_name == TOSHIBA_GUIDE_NAME) {return F(TOSHIBA_GUIDE_STRING);}
    else if (code_name == TOSHIBA_UP_NAME) {return F(TOSHIBA_UP_STRING);}
    else if (code_name == TOSHIBA_EXIT_NAME) {return F(TOSHIBA_EXIT_STRING);}
    else if (code_name == TOSHIBA_LEFT_NAME) {return F(TOSHIBA_LEFT_STRING);}
    else if (code_name == TOSHIBA_OK_NAME) {return F(TOSHIBA_OK_STRING);}
    else if (code_name == TOSHIBA_RIGHT_NAME) {return F(TOSHIBA_RIGHT_STRING);}
    else if (code_name == TOSHIBA_MENU_NAME) {return F(TOSHIBA_MENU_STRING);}
    else if (code_name == TOSHIBA_DOWN_NAME) {return F(TOSHIBA_DOWN_STRING);}
    else if (code_name == TOSHIBA_RETURN_NAME) {return F(TOSHIBA_RETURN_STRING);}
    else if (code_name == TOSHIBA_RED_NAME) {return F(TOSHIBA_RED_STRING);}
    else if (code_name == TOSHIBA_GREEN_NAME) {return F(TOSHIBA_GREEN_STRING);}
    else if (code_name == TOSHIBA_YELLOW_NAME) {return F(TOSHIBA_YELLOW_STRING);}
    else if (code_name == TOSHIBA_BLUE_NAME) {return F(TOSHIBA_BLUE_STRING);}
    else if (code_name == TOSHIBA_QUESTION_NAME) {return F(TOSHIBA_QUESTION_STRING);}
    else if (code_name == TOSHIBA_ZOOM_OUT_NAME) {return F(TOSHIBA_ZOOM_OUT_STRING);}
    else if (code_name == TOSHIBA_ZOOM_IN_NAME) {return F(TOSHIBA_ZOOM_IN_STRING);}
    else if (code_name == TOSHIBA_TIME_NAME) {return F(TOSHIBA_TIME_STRING);}

    return "NOT FOUND";

}